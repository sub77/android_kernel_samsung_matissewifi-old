/* Copyright (c) 2012-2013, The Linux Foundation. All rights reserved.
 *
 * This program is free software; you can redistribute it and/or modify
 * it under the terms of the GNU General Public License version 2 and
 * only version 2 as published by the Free Software Foundation.
 *
 * This program is distributed in the hope that it will be useful,
 * but WITHOUT ANY WARRANTY; without even the implied warranty of
 * MERCHANTABILITY or FITNESS FOR A PARTICULAR PURPOSE.  See the
 * GNU General Public License for more details.
 */

/{
	i2c@15{ /*SM5502 Chip node (similar to tsu7621 muic)*/
                cell-index = <15>;
                compatible = "i2c-gpio";
                gpios = <&msmgpio 14 0  /*SDA*/
                        &msmgpio 15 0  /*SCL*/
                        >;
                i2c-gpio,delay-us = <2>;
                #address-cells = <1>;
                #size-cells = <0>;
                sm5502@25{
                        compatible = "sm5502,i2c";
                        reg = <0x25>;
                        interrupt-parent = <&msmgpio>;
                        interrupts= <67 0>;
                        sm5502,irq-gpio = <&msmgpio 67 0x00>;
                        sm5502,gpio-sda = <&msmgpio 14 0x00>;
                        sm5502,gpio-scl = <&msmgpio 15 0x00>;
                        sm5502,uarton-gpio = <&msmgpio 109 0x00>;
		};
	};
};
